#include "socfpga_cyclone5.dtsi"
#include "socfpga_cyclone5_enclustra_mercury_sa1.dtsi"

/ {
	model = "Enclustra ME-SA1-C6-7I-D10 SOM";
	compatible = "altr,socfpga-cyclone5-socdk", "altr,socfpga-cyclone5", "altr,socfpga";

	memory@0 {
		name = "memory";
		device_type = "memory";
		reg = <0x0 0x40000000>; /* 1GB */
	};
};
