#include "socfpga_cyclone5.dtsi"
#include "socfpga_cyclone5_enclustra_mercury_sa2.dtsi"

/ {
	model = "Enclustra ME-SA2-D6-7I-D11 SOM";
	compatible = "altr,socfpga-cyclone5-socdk", "altr,socfpga-cyclone5", "altr,socfpga";

	memory@0 {
		name = "memory";
		device_type = "memory";
		reg = <0x0 0x80000000>; /* 2GB */
	};
};
