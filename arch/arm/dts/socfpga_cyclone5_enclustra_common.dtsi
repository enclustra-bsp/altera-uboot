/ {
	aliases {
		ethernet0 = &gmac1;
		spi0 = &qspi;
	};

	chosen {
		bootargs = "earlyprintk";
		stdout-path = "serial0:115200n8";
	};

	regulator_3_3v: 3-3-v-regulator {
		compatible = "regulator-fixed";
		regulator-name = "3.3V";
		regulator-min-microvolt = <3300000>;
		regulator-max-microvolt = <3300000>;
	};
};

&gpio0 {
	status = "okay";
};

&gpio1 {
	status = "okay";
};

&qspi {
	status = "okay";

	flash0: n25q00@0 {

		compatible = "n25q00";
		reg = <0>;	/* chip select */
		spi-max-frequency = <100000000>;

		m25p,fast-read;
		cdns,page-size = <256>;
		cdns,block-size = <16>; /* 2^16, 64KB */
		cdns,read-delay = <4>;  /* delay value in read data capture register */
		cdns,tshsl-ns = <50>;
		cdns,tsd2d-ns = <50>;
		cdns,tchsh-ns = <4>;
		cdns,tslch-ns = <4>;

/* TODO: check if needed */
		partition@qspi-boot {
			/* 8MB for raw data. */
			label = "Flash 0 Raw Data";
			reg = <0x0 0x800000>;
		};

		partition@qspi-rootfs {
			/* 120MB for jffs2 data. */
			label = "Flash 0 jffs2 Filesystem";
			reg = <0x800000 0x7800000>;
		};
	};
};

/* TODO: i2c not connected???
&i2c1 {
	status = "okay";
	clock-frequency = <50000>;
	/* Max value set according to HW spec */
	i2c-scl-falling-time-ns = <300>;
	
	isl12022: isl12022@6f {
		status = "okay";
		compatible = "isil,isl12022";
		reg = <0x6f>;
	};
};
*/

/*TODO: check if bank-name is needed
&porta {
	bank-name = "porta";
};

&portb {
	bank-name = "portb";
};

&portc {
	bank-name = "portc";
};
*/

&mmc0 {
	cd-gpios = <&portb 18 0>;
	vmmc-supply = <&regulator_3_3v>;
	vqmmc-supply = <&regulator_3_3v>;
	status = "okay";
};

&uart0 {
	u-boot,dm-pre-reloc;
	status = "okay";
	clock-frequency = <100000000>;
};

&uart1 {
	status = "disabled";
};

&watchdog0 {
	status = "disabled";
};

&watchdog1 {
	status = "disabled";
};